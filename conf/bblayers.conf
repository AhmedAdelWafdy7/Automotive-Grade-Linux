## conf/bblayers.conf
```bitbake
# POKY_BBLAYERS_CONF_VERSION is increased each time build/conf/bblayers.conf
# changes incompatibly
POKY_BBLAYERS_CONF_VERSION = "2"

BBPATH = "${TOPDIR}"
BBFILES ?= ""

BBLAYERS ?= " \
  /home/wafdunix/AGL/poky/meta \
  /home/wafdunix/AGL/poky/meta-poky \
  /home/wafdunix/AGL/poky/meta-yocto-bsp \
  /home/wafdunix/AGL/poky/meta-lts-mixins \
  /home/wafdunix/AGL/poky/meta-agl/meta-agl-core \
  /home/wafdunix/AGL/poky/meta-agl/meta-agl-bsp \
  /home/wafdunix/AGL/poky/meta-openembedded/meta-oe \
  /home/wafdunix/AGL/poky/meta-openembedded/meta-filesystems \
  /home/wafdunix/AGL/poky/meta-openembedded/meta-python \
  /home/wafdunix/AGL/poky/meta-openembedded/meta-multimedia \
  /home/wafdunix/AGL/poky/meta-openembedded/meta-networking \
  /home/wafdunix/AGL/poky/meta-qt5 \
  /home/wafdunix/AGL/poky/meta-python2 \
  /home/wafdunix/AGL/poky/meta-clang \
  /home/wafdunix/AGL/poky/meta-flutter \
  /home/wafdunix/AGL/poky/meta-agl-devel/meta-agl-flutter \
  /home/wafdunix/AGL/poky/meta-agl/meta-app-framework \
  /home/wafdunix/AGL/poky/meta-agl/meta-pipewire \
  /home/wafdunix/AGL/poky/meta-selinux \
  /home/wafdunix/AGL/poky/meta-raspberrypi \
  "
```
